## sdkconfig.defaults
```kconfig
# RustRemoteCWKeyer sdkconfig.defaults
# Based on proven configuration from similar CW keyer project

# Target
CONFIG_IDF_TARGET="esp32s3"

# Flash Configuration
CONFIG_ESPTOOLPY_FLASHSIZE_16MB=y
# Disable auto-reset after flash (USB native requires manual reset)
CONFIG_ESPTOOLPY_AFTER_NORESET=y

# Custom Partition Table (OTA + SPIFFS + Coredump)
# Note: Absolute path required because embuild's PROJECT_DIR doesn't work for custom partitions
# If building outside DevContainer, update this path
CONFIG_PARTITION_TABLE_CUSTOM=y
CONFIG_PARTITION_TABLE_CUSTOM_FILENAME="/workspaces/RustRemoteCWKeyer/partitions.csv"

# CPU Speed - 240MHz for maximum performance
CONFIG_ESP_DEFAULT_CPU_FREQ_MHZ_240=y

# FreeRTOS Configuration - CRITICAL for RT timing
# 1000Hz tick = 1ms resolution for precise CW timing
CONFIG_FREERTOS_HZ=1000
CONFIG_FREERTOS_USE_TRACE_FACILITY=y
CONFIG_FREERTOS_GENERATE_RUN_TIME_STATS=y
CONFIG_FREERTOS_RUN_TIME_STATS_USING_ESP_TIMER=y

# Main task stack size
CONFIG_ESP_MAIN_TASK_STACK_SIZE=8192

# Console Configuration
# Use UART as default (not USB Serial JTAG) to free USB for TinyUSB
CONFIG_ESP_CONSOLE_UART_DEFAULT=y
CONFIG_ESP_CONSOLE_USB_SERIAL_JTAG=n
CONFIG_ESP_CONSOLE_SECONDARY_NONE=y

# TinyUSB - Dual CDC Configuration
# CDC0: System logs (stdout redirect)
# CDC1: Interactive console
CONFIG_TINYUSB_CDC_ENABLED=y
CONFIG_TINYUSB_CDC_COUNT=2
CONFIG_TINYUSB_DEBUG_LEVEL=0
CONFIG_TINYUSB_CDC_RX_BUFSIZE=1024
CONFIG_TINYUSB_CDC_TX_BUFSIZE=4096

# Line endings - CRLF for proper terminal display
CONFIG_NEWLIB_STDOUT_LINE_ENDING_CRLF=y

# ISR safety for I2C/I2S (audio sidetone)
CONFIG_I2C_ISR_IRAM_SAFE=y
CONFIG_I2S_ISR_IRAM_SAFE=y

# Panic behavior - print and halt for debugging
CONFIG_ESP_SYSTEM_PANIC_PRINT_HALT=y

# Core dump to flash for crash debugging
CONFIG_ESP_COREDUMP_ENABLE_TO_FLASH=y
CONFIG_ESP_COREDUMP_DATA_FORMAT_ELF=y
CONFIG_ESP_COREDUMP_CHECKSUM_CRC32=y
CONFIG_ESP_COREDUMP_MAX_TASKS_NUM=64

# PSRAM Configuration (if board has it)
CONFIG_SPIRAM=y
CONFIG_SPIRAM_MODE_OCT=y
CONFIG_SPIRAM_SPEED_80M=y
CONFIG_SPIRAM_USE_CAPS_ALLOC=y
CONFIG_SPIRAM_MALLOC_ALWAYSINTERNAL=32
CONFIG_SPIRAM_MALLOC_RESERVE_INTERNAL=32768

# WiFi Configuration (for remote operation)
CONFIG_ESP_WIFI_ENABLED=y
CONFIG_ESP_WIFI_STATIC_RX_BUFFER_NUM=10
CONFIG_ESP_WIFI_DYNAMIC_RX_BUFFER_NUM=32
CONFIG_ESP_WIFI_DYNAMIC_TX_BUFFER_NUM=32
CONFIG_ESP_WIFI_AMPDU_TX_ENABLED=y
CONFIG_ESP_WIFI_AMPDU_RX_ENABLED=y
CONFIG_ESP_WIFI_NVS_ENABLED=n

# TCP/IP Stack
CONFIG_LWIP_MAX_SOCKETS=10
CONFIG_LWIP_SO_REUSE=y
CONFIG_LWIP_SO_RCVBUF=y
CONFIG_LWIP_NETIF_LOOPBACK=y
CONFIG_LWIP_NETIF_STATUS_CALLBACK=y

# HTTP Server (for web interface)
CONFIG_HTTPD_MAX_REQ_HDR_LEN=1024
CONFIG_HTTPD_MAX_URI_LEN=512
CONFIG_HTTPD_ERR_RESP_NO_DELAY=y

# mDNS (for keyer.local discovery)
CONFIG_MDNS_MAX_INTERFACES=3
```
